## rims-mvp/main/Kconfig.projbuild
```kconfig
menu "RIMS Bean"

    config REC_VAD_RMS
        int "VAD 静音检测 RMS 阈值（16bit 满量程 32768）"
        default 500
        help
            高于此值视为有人说话。环境吵/说话小声可调。

endmenu
```

## rims-mvp/sdkconfig.defaults
```kconfig
# RIMS 录音豆 MVP · EasyInput V2 板（ESP32-S3）临时载体
CONFIG_IDF_TARGET="esp32s3"
CONFIG_IDF_TARGET_ESP32S3=y
# 板为 16MB Flash（此前 8MB 为笔误，已按板级事实修正）
CONFIG_ESPTOOLPY_FLASHSIZE_16MB=y
CONFIG_ESPTOOLPY_HEADER_FLASHSIZE_UPDATE=n
# V2 使用 ESP32-S3R8：8MB Octal PSRAM 只给显式 MALLOC_CAP_SPIRAM 的分配用
CONFIG_SPIRAM=y
CONFIG_SPIRAM_MODE_OCT=y
CONFIG_SPIRAM_SPEED_80M=y
CONFIG_SPIRAM_TYPE_AUTO=y
CONFIG_SPIRAM_BOOT_INIT=y
CONFIG_SPIRAM_IGNORE_NOTFOUND=n
CONFIG_SPIRAM_USE_CAPS_ALLOC=y
CONFIG_PARTITION_TABLE_CUSTOM=y
CONFIG_PARTITION_TABLE_CUSTOM_FILENAME="partitions.csv"
CONFIG_PARTITION_TABLE_OFFSET=0x8000
CONFIG_FREERTOS_HZ=1000
CONFIG_ESP_MAIN_TASK_STACK_SIZE=8192
# 诊断：日志走 USB-Serial-JTAG（COM 口可读启动日志；不影响 SoftAP/业务）
CONFIG_ESP_CONSOLE_USB_SERIAL_JTAG=y
```
